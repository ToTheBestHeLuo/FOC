/*
 * @Author: ToTheBestHeLuo 2950083986@qq.com
 * @Date: 2024-07-04 09:16:17
 * @LastEditors: error: error: git config user.name & please set dead value or install git && error: git config user.email & please set dead value or install git & please set dead value or install git
 * @LastEditTime: 2024-08-16 14:43:23
 * @FilePath: \MDK-ARMd:\stm32cube\stm32g431rbt6_advanced\FOC\source\mcMath.c
 * @Description: 
 * 
 * Copyright (c) 2024 by ${git_name_email}, All Rights Reserved. 
 */
#include "../include/mcType.h"
#include "../interface/mcConfig.h"
#include "../include/mcMath.h"

#define sqrt3 1.732050807568877f

bool CalculateIsInLimited(f32_t in,f32_t limit)
{
    limit = abs(limit);
    in = abs(in);
    if(in > limit) return false;
    return true;
}

f32_t CalculateSquare(f32_t in)
{
    return in * in;
}

Components2 CalculateSinCosValue(f32_t eleAngle)
{
    Components2 sinCos = Hardware_GetSinCosVal(eleAngle);
    return sinCos;
}
Components2 Abc_AlphaBeta_Trans(_FORCE Components2* ab)
{
    Components2 alphaBeta;
    alphaBeta.com1 = ab->com1;
    alphaBeta.com2 = sqrt3 / 3.f * (2.f * ab->com2 + ab->com1);
    return alphaBeta;
}
Components3 AlphaBeta_Abc_Trans(_FORCE Components2* alphaBeta)
{
    Components3 abc;
    f32_t alpha = alphaBeta->com1;
    f32_t beta = alphaBeta->com1;
    abc.com1 = alpha + sqrt3 / 3.f * beta;
    abc.com2 = sqrt3 * 2.f / 3.f * beta;
    abc.com3 = -(abc.com1 + abc.com2);
    return abc;
}
Components2 AlphaBeta_Dq_Trans(_FORCE Components2* alphaBeta,_FORCE Components2* sinCos)
{
    Components2 dq;
    dq.com1 = sinCos->com2 * alphaBeta->com1 + sinCos->com1 * alphaBeta->com2;
    dq.com2 = -sinCos->com1 * alphaBeta->com1 + sinCos->com2 * alphaBeta->com2;
    return dq;
}
Components2 Dq_AlphaBeta_Trans(_FORCE Components2* dq,_FORCE Components2* sinCos)
{
    Components2 alphaBeta;
    alphaBeta.com1 = sinCos->com2 * dq->com1 - sinCos->com1 * dq->com2;
    alphaBeta.com2 = sinCos->com1 * dq->com1 + sinCos->com2 * dq->com2;
    return alphaBeta;
}
f32_t FastSquareRoot(f32_t x)
{
    return Hardware_FastSquareRoot(x);
}
f32_t FastReciprocalSquareRoot(f32_t x)
{
    return Hardware_FastReciprocalSquareRoot(x);
}
f32_t Min3(f32_t x1,f32_t x2,f32_t x3)
{
    f32_t min = x1;
    if(min > x2)
        min = x2;
    if(min > x3)
        min = x3;
    return min;
}
f32_t Max3(f32_t x1,f32_t x2,f32_t x3)
{
    f32_t max = x1;
    if(max < x2)
        max = x2;
    if(max < x3)
        max = x3;
    return max;
}

f32_t MedianFilter(f32_t datBuffer[],uint16_t length)
{
    f32_t res = 0.f;

    if(length < 3){
        return res;
    }

    for(int i = 0;i < length - 1;++i){
        for(int j = 0;j < length - i - 1;++j){
            if(datBuffer[j] > datBuffer[j + 1]){
                f32_t tmp = datBuffer[j];
                datBuffer[j] = datBuffer[j + 1];
                datBuffer[j + 1] = tmp;
            }
        }
    }

    return datBuffer[length / 2];
}

uint32_t plook_evencg(f32_t u, f32_t bp0, f32_t bpSpace, uint32_t
    maxIndex, f32_t* fraction)
{
    f32_t fbpIndex;
    f32_t invSpc;
    uint32_t bpIndex;

    invSpc = 1.0f / bpSpace;
    fbpIndex = (u - bp0) * invSpc;
    if (fbpIndex < maxIndex) {
        bpIndex = (uint32_t)fbpIndex;
        *fraction = (u - ((f32_t)(uint32_t)fbpIndex * bpSpace + bp0)) * invSpc;
    }
    else {
        bpIndex = maxIndex - 1U;
        *fraction = 1.0f;
    }

    return bpIndex;
}

f32_t intrp1d_l(uint32_t bpIndex, f32_t frac, const f32_t table[])
{
    f32_t yL_0d0;

    yL_0d0 = table[bpIndex];
    return (table[bpIndex + 1U] - yL_0d0) * frac + yL_0d0;
}

f32_t atan2Rad(f32_t x1,f32_t x2)
{
    f32_t absInXVar;
    f32_t rtb_Atan2;
    static const f32_t tableData_c[255] = { 0.0, 0.000626591026761255,
      0.00125316262996467, 0.001879695389664802, 0.002506169893139322,
      0.0031325667384963776, 0.0037588665382769179, 0.0043850499230503187,
      0.005011097545001641, 0.00563699008150886, 0.0062627082387084251,
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      0.12405453621245152, 0.12437093235460782, 0.12468608533194264, 0.125 };

    if ((x1 == 0.0f) && (x2 == 0.0f)) {
        rtb_Atan2 = 0.0f;
    }
    else {
        f32_t uVarXTmp;
        uint32_t bpIdx;
        uint8_t quadrantInfo;
        bool isReciprocal;
        isReciprocal = false;
        if (x1 < 0.0f) {
            if (x2 < 0.0f) {
                quadrantInfo = 3U;
            }
            else {
                quadrantInfo = 4U;
            }
        }
        else if (x2 < 0.0f) {
            quadrantInfo = 2U;
        }
        else {
            quadrantInfo = 1U;
        }

        absInXVar = abs(x2);
        rtb_Atan2 = abs(x1);
        if (rtb_Atan2 > absInXVar) {
            uVarXTmp = rtb_Atan2;
            rtb_Atan2 = absInXVar;
            isReciprocal = true;
        }
        else {
            uVarXTmp = absInXVar;
        }

        bpIdx = plook_evencg(rtb_Atan2 / uVarXTmp, 0.0f, 0.003937007874015748f, 254U,
            &absInXVar);
        rtb_Atan2 = intrp1d_l(bpIdx, absInXVar, tableData_c);
        if (isReciprocal) {
            rtb_Atan2 = 0.25f - rtb_Atan2;
        }

        if (quadrantInfo == 2) {
            rtb_Atan2 = 0.5f - rtb_Atan2;
        }
        else if (quadrantInfo == 3) {
            rtb_Atan2 -= 0.5f;
        }
        else if (quadrantInfo == 4) {
            rtb_Atan2 = -rtb_Atan2;
        }
    }
    
    return rtb_Atan2 * 6.2831853071795862f;
}


